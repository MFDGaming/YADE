ENTRY(_start)

IS_V300E = DEFINED(V300E);
IS_V300U = DEFINED(V300U);
IS_V300J = DEFINED(V300J);
IS_V302J = DEFINED(V302J);
IS_V302U = DEFINED(V302U);
IS_V302A = DEFINED(V302A);
IS_V302E = DEFINED(V302E);
IS_V302K = DEFINED(V302K);
IS_V302G = DEFINED(V302G);
IS_V302D = DEFINED(V302D);
IS_V302C = DEFINED(V302C);
IS_V303J = DEFINED(V303J);
IS_V303E = DEFINED(V303E);
IS_V304M = DEFINED(V304M);
IS_V304J = DEFINED(V304J);

BV300E = 0x0155d510;
BV300U = 0x01387f10;
BV300J = 0x01103710;
BV302J = 0x01152790;
BV302U = 0x013d8b10;
BV302A = 0;
BV302E = 0x015ae110;
BV302K = 0x01324590;
BV302G = 0x01325b10;
BV302D = 0x0131a190;
BV302C = 0x01390010;
BV303J = 0x0119e690;
BV303E = 0x015f9b10;
BV304M = 0x016d4750;
BV304J = 0x01279350;

BASE = (
    IS_V300E ? BV300E : (
    IS_V300U ? BV300U : (
    IS_V300J ? BV300J : (
    IS_V302J ? BV302J : (
    IS_V302U ? BV302U : (
    IS_V302A ? BV302A : (
    IS_V302E ? BV302E : (
    IS_V302K ? BV302K : (
    IS_V302G ? BV302G : (
    IS_V302D ? BV302D : (
    IS_V302C ? BV302C : (
    IS_V303J ? BV303J : (
    IS_V303E ? BV303E : (
    IS_V304M ? BV304M : (
    IS_V304J ? BV304J : 0
)))))))))))))));

SECTIONS
{
    .text BASE : {
        *(.text.boot)
        *(.text*)
    }
    .rodata : { *(.rodata*) }
    .data : { *(.data*) }
    .bss : { *(.bss*) *(COMMON) }
}
